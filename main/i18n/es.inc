/* SPDX-License-Identifier: LicenseRef-FNCL-1.1
 * Copyright (c) 2026 andre68723
 * Generated by tools/generate_i18n.py; edit the JSON catalog.
 */
static const char I18N_BUILTIN_ES[] =
    "{\"lvgl\":{"
    "\"common\":{\"on\":\"ENCENDIDO\",\"off\":\"APAGADO\",\"unavailable\":\"no disponible\",\"paused\":\"pausado\",\"playing\":\"reproduciendo\",\"start\":\"Iniciar\",\"pause\":\"Pausa\",\"unknown\":\"Desconocido\"},"
    "\"cover\":{\"open\":\"Abierto\",\"closed\":\"Cerrado\",\"opening\":\"Abriendo\",\"closing\":\"Cerrando\",\"moving\":\"En movimiento\"},"
    "\"datetime\":{\"date\":\"Fecha\",\"time\":\"Hora\",\"save\":\"Guardar\",\"cancel\":\"Cancelar\",\"invalid\":\"Fecha u hora no válida\",\"failed\":\"No se pudo guardar\"},"
    "\"history\":{\"loading\":\"Cargando historial...\",\"empty\":\"Sin historial registrado\",\"shortened\":\"Historial abreviado para ajustarse\",\"error\":\"No se pudo cargar el historial\",\"min\":\"Mín.\",\"max\":\"Máx.\",\"range_day\":\"24 h\",\"range_week\":\"7 días\",\"hourly_mean\":\"Medias horarias\",\"week_empty\":\"Sin estadísticas de los últimos 7 días\",\"week_error\":\"No se pudieron cargar las estadísticas\",\"days_total\":\"Últimos 7 días\",\"days_title\":\"Consumo diario\",\"days_partial\":\"Barras claras: día incompleto\",\"days_sources\":\"Faltan algunas fuentes\",\"days_unsupported\":\"Sin estadísticas para esta fuente\",\"range_30d\":\"30 d\",\"range_12m\":\"12 meses\",\"daily_mean\":\"Medias diarias\",\"weekly_mean\":\"Medias semanales\",\"range_empty_30d\":\"Aún no hay estadísticas de 30 días\",\"range_empty_12m\":\"Aún no hay estadísticas de 12 meses\",\"days_production\":\"Producción diaria\"},"
    "\"energytl\":{\"home\":\"Consumo del hogar\",\"solar\":\"De solar\",\"grid\":\"De la red\",\"export\":\"Vertido a la red\",\"battery\":\"De la batería\",\"home_s\":\"Hogar\",\"export_s\":\"Vertido a la red\",\"solar_s\":\"Solar\",\"battery_s\":\"Bateria\",\"c_solar\":\"Solar\",\"c_battery\":\"Bateria\",\"c_grid\":\"Red\",\"c_export\":\"Vertido a la red\",\"c_charge\":\"Cargando\",\"c_forecast\":\"Previsión\",\"loading\":\"Cargando ...\",\"stale\":\"Desactualizado\",\"nostats\":\"Sin estadísticas\",\"nostats_hint\":\"Home Assistant no tiene estadísticas a largo plazo del contador de importación de red. Requiere state_class total o total_increasing.\",\"updated\":\"Actualizado %s\",\"partial\":\"%d de %d intervalos incompletos\",\"measured\":\"Medido, últimas 24 horas\",\"import\":\"Consumo de la red\",\"export_meter\":\"Exportación a red\",\"solar_meter\":\"Producción solar\",\"charge\":\"Carga de batería\",\"discharge\":\"Descarga de batería\",\"soc\":\"Nivel de batería\",\"forecast\":\"Previsión solar\",\"mix_estimated\":\"Mezcla (estimada)\",\"mix\":\"Mezcla\",\"home_from_solar\":\"  de solar\",\"home_from_battery\":\"  de batería\",\"home_from_grid\":\"  de red\",\"export_from_solar\":\"  de solar\",\"export_from_battery\":\"  de batería\",\"charge_from_solar\":\"  de solar\",\"charge_from_grid\":\"  de red\",\"estimate_note\":\"Estimación: los contadores agregados no distinguen si la energía de red cargó la batería o abasteció la casa. Solar abastece primero la casa, luego la batería y luego la red; la batería cubre lo que aún falta en casa. Los valores medidos anteriores son exactos.\"},"
    "\"room\":{\"switches_off\":\"Interruptores apagados\",\"switch_on\":\"Interruptor encendido\",\"switches_on_n\":\"%d interruptores encendidos\",\"idle\":\"Listo\",\"closed\":\"Cerrado\",\"open_n\":\"%d abiertos\",\"lights_off\":\"Luces apagadas\",\"light_on\":\"Luz encendida\",\"lights_on_n\":\"%d luces encendidas\",\"present\":\"Presente\",\"empty\":\"Vacío\",\"battery_n\":\"%d baterías bajas\"},"
    "\"binary\":{\"just_now\":\"ahora mismo\",\"ringing\":\"Activado\",\"last\":\"Último\",\"no_event\":\"Sin evento\",\"home\":\"Hogar\",\"away\":\"Fuera\",\"motion\":\"Movimiento\",\"clear\":\"Despejado\",\"unlocked\":\"Desbloqueado\",\"locked\":\"Bloqueado\",\"wet\":\"Mojado\",\"dry\":\"Seco\",\"alarm\":\"Alarma\",\"ok\":\"OK\",\"low\":\"Bajo\",\"connected\":\"Conectado\",\"disconnected\":\"Desconectado\",\"on\":\"Encendido\",\"off\":\"Apagado\"},"
    "\"scene\":{\"scene\":\"Escena\",\"script\":\"Script\",\"button\":\"Botón\",\"lock\":\"Desbloquear\"},"
    "\"lock\":{\"state\":{\"locked\":\"Bloqueado\",\"unlocked\":\"Desbloqueado\",\"locking\":\"Bloqueando ...\",\"unlocking\":\"Desbloqueando ...\",\"open\":\"Abierto\",\"opening\":\"Abriendo ...\",\"jammed\":\"Atascado\"},\"lock\":\"Cerradura\",\"unlock\":\"Desbloquear\",\"open\":\"Abierto\",\"confirm_unlock\":\"¿Desbloquear %s?\",\"confirm_open\":\"¿Abrir %s?\"},"
    "\"alarm\":{\"state\":{\"disarmed\":\"Desarmado\",\"armed_home\":\"Armado en casa\",\"armed_away\":\"Armado fuera\",\"armed_night\":\"Armado de noche\",\"armed_vacation\":\"Armado de vacaciones\",\"armed_custom_bypass\":\"Armado personalizado\",\"arming\":\"Armando ...\",\"pending\":\"Pendiente\",\"disarming\":\"Desarmando ...\",\"triggered\":\"Activado\"},\"action\":{\"disarm\":\"Desarmar\",\"arm_home\":\"Armar en casa\",\"arm_away\":\"Armar fuera\",\"arm_night\":\"Armar de noche\",\"arm_vacation\":\"Armar de vacaciones\",\"arm_custom_bypass\":\"Armar con exclusión personalizada\"},\"ok\":\"OK\",\"zones\":\"Zonas\",\"controls\":\"Controles\",\"history\":\"Historial\",\"refresh\":\"Actualizar\",\"hold\":\"Mantener 2 s\",\"enter_code\":\"Introducir código\",\"no_code\":\"No requiere código\",\"text_code\":\"Código de texto: usar Home Assistant\",\"btn\":{\"disarm\":\"Desarmar\",\"away\":\"Armar ausente\",\"home\":\"Armar en casa\",\"night\":\"Armar noche\",\"vacation\":\"Vacaciones\"},\"msg\":{\"sent\":\"Solicitud en cola\",\"failed\":\"Solicitud fallida\",\"accepted\":\"Solicitud aceptada\",\"rejected\":\"Solicitud fallida o rechazada\",\"enter_code\":\"Introduzca primero el código\"},\"log\":{\"loading\":\"Cargando…\",\"failed\":\"Historial no disponible\",\"empty\":\"Sin eventos\",\"no_clock\":\"Esperando sincronización\"},\"pressed\":\"Pulsado\",\"zone\":{\"detected\":\"Detectado\",\"ok\":\"Correcto\",\"motion\":\"Movimiento\",\"clear\":\"Libre\",\"open\":\"Abierto\",\"closed\":\"Cerrado\",\"active\":\"Activo\",\"inactive\":\"Inactivo\",\"not_ready\":\"No preparado\"},\"zones_active\":\"zonas activas\",\"zones_ready\":\"Todas las zonas libres\"},"
    "\"vacmode\":{\"vacuum\":\"Aspirador\",\"mop\":\"Fregar\",\"vac_and_mop\":\"Aspirar y fregar\",\"vacuum_and_mop\":\"Aspirar y fregar\",\"mop_after_vac\":\"Aspirar y luego fregar\",\"mop_after_vacuum\":\"Aspirar y luego fregar\",\"quick_vac\":\"Aspirado rápido\",\"auto_vac\":\"Aspirado automático\",\"deep_clean_vac\":\"Aspirado profundo\",\"quiet_vac\":\"Aspirado silencioso\",\"quick_mop\":\"Fregado rápido\",\"auto_mop\":\"Fregado automático\",\"deep_clean_mop\":\"Fregado profundo\",\"quick_vac_and_mop\":\"Aspirar y fregar rápido\",\"auto_vac_and_mop\":\"Aspirar y fregar automático\",\"deep_clean_vac_and_mop\":\"Aspirar y fregar profundo\",\"quiet_vac_and_mop\":\"Aspirar y fregar silencioso\",\"custom\":\"Personalizado\"},"
    "\"car\":{\"precond\":\"Preacond.\",\"precond_pending\":\"Enviando...\"},"
    "\"fan\":{\"oscillate\":\"Oscilar\"},"
    "\"contact\":{\"open\":\"Abierto\",\"opened\":\"Abierto\",\"closed\":\"Cerrado\"},"
    "\"climate\":{\"current\":\"Ahora\",\"fan_short\":\"Ventilador\",\"fan_title\":\"Modo de ventilador\",\"mode_title\":\"Modo\",\"swing_short\":\"Oscilación\",\"swing_title\":\"Modo de oscilación\",\"mode\":{\"off\":\"Apagado\",\"heat\":\"Calor\",\"cool\":\"Frio\",\"auto\":\"Automático\",\"dry\":\"Seco\",\"fan_only\":\"Solo ventilador\",\"heat_cool\":\"Calor/Frío\",\"cooling\":\"Enfriando\",\"drying\":\"Secando\",\"idle\":\"Listo\",\"fan\":\"Ventilador\",\"defrosting\":\"Descongelando\",\"preheating\":\"Precalentando\",\"vertical\":\"Vertical\",\"horizontal\":\"Horizontal\",\"both\":\"Ambos\"}},"
    "\"roborock\":{\"fan_title\":\"Nivel de succión\",\"ready\":\"Listo\",\"cleaning\":\"Limpiando\",\"returning\":\"Regresando\",\"dock\":\"Base\",\"fan\":\"Ventilador\",\"clean_selected_short\":\"Limpiar\",\"map_ready\":\"Mapa conectado\",\"map_loading\":\"Cargando mapa\",\"map_waiting\":\"Esperando mapa\",\"map_failed\":\"Vista de mapa no disponible\",\"ready_to_charge\":\"En la base\",\"mode\":\"Modo\",\"mode_title\":\"Modo de limpieza\",\"send_failed\":\"Orden no enviada\",\"not_connected\":\"Home Assistant sin conexión\",\"state\":{\"cleaning\":\"Limpiando\",\"docked\":\"En la base\",\"returning\":\"Regresando\",\"idle\":\"Listo\",\"paused\":\"En pausa\",\"error\":\"Error\",\"unavailable\":\"No disponible\",\"unknown\":\"Desconocido\",\"segment_cleaning\":\"Limpieza de habitación\",\"room_cleaning\":\"Limpieza de habitación\",\"zoned_cleaning\":\"Limpieza de zona\",\"spot_cleaning\":\"Limpieza puntual\",\"going_to_target\":\"Yendo al destino\",\"target_found\":\"Destino alcanzado\"}},"
    "\"topbar\":{\"ha\":\"HA\",\"ap\":\"AP\"},"
    "\"sensor\":{\"age\":{\"just_now\":\"ahora mismo\",\"min_one\":\"hace 1 min\",\"min_many\":\"hace %d min\",\"hour_one\":\"hace 1 hora\",\"hour_many\":\"hace %d horas\",\"day_one\":\"hace 1 dia\",\"day_many\":\"hace %d dias\"},\"in\":{\"now\":\"ahora\",\"min_one\":\"en 1 min\",\"min_many\":\"en %d min\",\"hour_one\":\"en 1 hora\",\"hour_many\":\"en %d horas\",\"day_one\":\"en 1 día\",\"day_many\":\"en %d días\"},\"day\":{\"today\":\"hoy\",\"tomorrow\":\"mañana\",\"yesterday\":\"ayer\"},\"dur\":{\"d\":\"d\",\"h\":\"h\",\"min\":\"min\",\"s\":\"s\"}},"
    "\"heating\":{\"target_format\":\"Objetivo %.1f°C\",\"active\":\"calefaccion activa\"},"
    "\"light\":{\"effect\":\"Efecto\",\"color_title\":\"Color de luz\",\"white\":\"Blanco\",\"color_temperature\":\"Temperatura de color\",\"warm\":\"Calido\",\"cool\":\"Frio\",\"rgb_color\":\"Color RGB\",\"presets\":\"Preajustes\",\"hue\":\"Tono\",\"saturation\":\"Saturación\"},"
    "\"weather\":{\"unavailable\":\"No disponible\",\"humidity_format\":\"Humedad %d%%\",\"low_short\":\"Mínima\",\"rain_short\":\"Lluvia\",\"now\":\"Ahora\",\"today\":\"Hoy\",\"report_title\":\"Informe meteorológico\",\"day_full_0\":\"Domingo\",\"day_full_1\":\"Lunes\",\"day_full_2\":\"Martes\",\"day_full_3\":\"Miércoles\",\"day_full_4\":\"Jueves\",\"day_full_5\":\"Viernes\",\"day_full_6\":\"Sábado\",\"pressure\":\"Presión\",\"wind_gust\":\"Ráfagas\",\"uv_index\":\"Índice UV\",\"cloud_cover\":\"Nubosidad\",\"sunshine\":\"Sol\",\"rain_duration\":\"Duración de lluvia\",\"dew_point\":\"Punto de rocío\",\"humidity\":\"Humedad\",\"wind\":\"Viento\",\"visibility\":\"Visibilidad\",\"rain_chance\":\"Probabilidad de lluvia\",\"precipitation\":\"Precipitación\",\"compass\":\"N,NE,E,SE,S,SO,O,NO\",\"weekday_0\":\"Dom\",\"weekday_1\":\"Lun\",\"weekday_2\":\"Mar\",\"weekday_3\":\"Mié\",\"weekday_4\":\"Jue\",\"weekday_5\":\"Vie\",\"weekday_6\":\"Sáb\",\"condition\":{\"clear_night\":\"Noche despejada\",\"cloudy\":\"Nublado\",\"exceptional\":\"Excepcional\",\"fog\":\"Niebla\",\"hail\":\"Granizo\",\"lightning\":\"Rayos\",\"lightning_rainy\":\"Rayos y lluvia\",\"partlycloudy\":\"Parcialmente nublado\",\"pouring\":\"Lluvia intensa\",\"rainy\":\"Lluvia\",\"snowy\":\"Nieve\",\"snowy_rainy\":\"Nieve y lluvia\",\"sunny\":\"Soleado\",\"windy\":\"Ventoso\",\"windy_variant\":\"Ventoso y nublado\"},\"hourly_empty\":\"Sin previsión por horas\",\"hourly_loading\":\"Cargando previsión por horas…\",\"view_days\":\"Días\"},"
    "\"graph\":{\"no_history\":\"sin historial\",\"no_data\":\"sin datos\",\"min\":\"min\",\"max\":\"máx.\"},"
    "\"notification\":{\"dismiss\":\"Descartar\",\"action\":\"Abierto\",\"sent\":\"Enviado\"},"
    "\"conn\":{\"wifi\":\"Wi-Fi\",\"ha\":\"Home Assistant\",\"mqtt\":\"MQTT\",\"status\":\"Estado\",\"host\":\"Host\",\"broker\":\"Broker\",\"device_id\":\"ID del dispositivo\",\"connected\":\"Conectado\",\"disconnected\":\"Sin conexión\",\"syncing\":\"Conectado, sincronizando\",\"disabled\":\"Deshabilitado\",\"diag_reason\":\"Causa de última desconexión\",\"diag_reconnects\":\"Intentos de reconexión\",\"diag_hard_recover\":\"Recuperación completa C6\",\"firmware\":\"Firmware\",\"version\":\"Versión\",\"built\":\"Compilado\",\"update_available\":\"Actualización disponible\",\"reconnect\":\"Reconectar\",\"reconnecting\":\"Reconectando…\",\"retry_hint\":\"Corrige el acceso o elimina el bloqueo de IP en Home Assistant antes de reconectar.\",\"access\":\"Acceso\",\"forbidden\":\"Denegado (HTTP 403); revisa bloqueos IP de HA\",\"token_rejected\":\"Token de acceso rechazado\",\"no_rejection\":\"No se ha indicado ningún rechazo\"},"
    "\"wifi\":{\"info\":{\"ip\":\"Dirección IP\",\"signal\":\"Intensidad de señal\",\"setup_ap\":\"AP de configuración activo\",\"signal_excellent\":\"Excelente\",\"signal_good\":\"Buena\",\"signal_fair\":\"Aceptable\",\"signal_weak\":\"Débil\"}},"
    "\"solar\":{\"rest\":\"Restante\",\"today\":\"Hoy\",\"tomorrow\":\"Mañana\",\"day_3\":\"Día 3\",\"day_4\":\"Día 4\",\"day_5\":\"Día 5\",\"day_generic\":\"Día\",\"weekday_0\":\"Do\",\"weekday_1\":\"Lu\",\"weekday_2\":\"Ma\",\"weekday_3\":\"Mi\",\"weekday_4\":\"Ju\",\"weekday_5\":\"Vi\",\"weekday_6\":\"Sá\",\"details_title\":\"Previsión solar de hoy\",\"remaining\":\"Restante\",\"total\":\"Total\",\"day_6\":\"Día 6\",\"day_7\":\"Día 7\"},"
    "\"energy\":{\"title\":\"Energia\",\"waiting\":\"Esperando datos de energia\",\"ha_waiting\":\"Datos de HA Energy\",\"today\":\"Hoy\",\"grid\":\"Red\",\"solar\":\"Solar\",\"home\":\"Hogar\",\"battery\":\"Bateria\",\"grid_in\":\"entrada\",\"grid_out\":\"salida\",\"battery_charge\":\"carga\",\"battery_out\":\"salida\",\"home_now\":\"Hogar ahora\",\"water\":\"Agua\",\"gas\":\"Gas\",\"autarky\":\"Autosuficiencia\",\"details_prompt\":\"Elige Gas, Agua o Solar\"},"
    "\"sonos_favorites\":{\"sensor_hint\":\"Requiere HA Sonos y sensor de favoritos habilitado.\",\"setup_hint\":\"Habilita Sonos y sensor.sonos_favorites en Home Assistant.\",\"empty\":\"Sin favoritos.\"},"
    "\"evcc\":{\"wallbox\":\"Cargador\",\"add\":\"+ Cargador (evcc)\",\"loadpoint\":\"Punto de carga\",\"choose\":\"Elige un punto de carga\",\"find\":\"Buscar puntos de carga\",\"finding\":\"Buscando puntos de carga...\",\"failed\":\"Sin confirmar\",\"none_found\":\"No se encontraron puntos de carga evcc habilitados\",\"replace\":\"¿Sustituir las entidades existentes por las de este punto de carga? Se reemplazarán las asignaciones manuales.\",\"missing\":\"Entidades ausentes o deshabilitadas\",\"bound\":\"Punto de carga configurado\",\"entities\":\"Entidades avanzadas\",\"hint\":\"Las entidades ausentes deben habilitarse en Home Assistant. La detección conserva las asignaciones manuales.\",\"mode\":\"Modo de carga\",\"vehicle\":\"Vehículo\",\"target\":\"Carga objetivo\",\"power\":\"Potencia de carga (sensor)\",\"soc\":\"Carga del vehículo (sensor)\",\"connected\":\"Conectado\",\"charging\":\"Cargando\",\"disabled\":\"Deshabilitado en configuración (binary_sensor)\",\"effective\":\"Efectivo\",\"off\":\"Apagado\",\"smart\":\"Inteligente\",\"fast\":\"Rápido\",\"none\":\"Sin vehículo\",\"ready\":\"Sin conexión\",\"unavailable\":\"No disponible\",\"pending\":\"Esperando...\",\"apply\":\"Aplicar\",\"energy\":\"Energía cargada (sensor)\",\"remaining\":\"Restante\",\"sessions\":\"Sesiones\",\"charged\":\"Cargado\",\"change\":\"Cambiar\",\"last\":\"Última sesión\",\"power_label\":\"Potencia\",\"soc_label\":\"SOC\",\"target_label\":\"Carga objetivo\",\"car\":\"Vehículo\",\"start\":\"Iniciar\",\"sessions_loading\":\"Cargando sesiones...\",\"sessions_error\":\"No se pudieron cargar las sesiones\",\"sessions_empty\":\"Sin sesiones completadas\",\"sessions_unsupported\":\"Sesiones no disponibles\",\"sessions_preview\":\"Sesiones disponibles en el panel\",\"header_power\":\"Potencia de carga\",\"flow_pv\":\"FV\",\"flow_battery\":\"Bateria\",\"flow_grid\":\"Red\",\"flow_home\":\"Hogar\",\"flow_car\":\"Coche\",\"flow_export\":\"Vertido a red\",\"guest\":\"Vehículo invitado\"},"
    "\"camera\":{\"live\":\"Cámara en directo\",\"connecting\":\"Conectando...\",\"paused\":\"En pausa\",\"waiting\":\"Esperando cámara\",\"unsupported\":\"MJPEG no disponible\",\"failed\":\"Conexión de cámara perdida\",\"snapshot_failed\":\"Imagen no disponible\"},"
    "\"bambu\":{\"state\":{\"missing\":\"Sin datos\",\"unavailable\":\"No disponible\",\"other\":\"Desconocido\",\"offline\":\"Sin conexión\",\"idle\":\"Listo\",\"init\":\"Iniciando\",\"prepare\":\"Preparando\",\"slicing\":\"Laminando\",\"running\":\"Imprimiendo\",\"pause\":\"En pausa\",\"finish\":\"Finalizado\",\"failed\":\"Fallido\"},\"pause\":\"Pausa\",\"resume\":\"Reanudar\",\"stop\":\"Detener\",\"status\":\"Estado\",\"nozzle\":\"Boquilla\",\"bed\":\"Cama\",\"progress\":\"Progreso\",\"remaining\":\"Restante\",\"min\":\"min\",\"stage\":\"Paso\",\"job\":\"Trabajo\",\"stop_title\":\"¿Detener esta impresión?\",\"cancel\":\"Cancelar\",\"not_confirmed\":\"Comando sin confirmar\",\"send_failed\":\"No se pudo enviar el comando\",\"sending\":\"Enviando...\",\"last_job\":\"Último trabajo\",\"details\":\"Estado de impresora\",\"not_connected\":\"Home Assistant sin conexión\",\"step\":{\"filament_loading\":\"Cargando filamento\",\"print_calibration_lines\":\"Imprimiendo líneas de calibración\",\"preparing_ams\":\"Preparando AMS\",\"preparing_hotend\":\"Preparando el hotend\",\"moving_toolhead_above_purge_chute\":\"Moviendo a la salida de purga\",\"paused_nozzle_clog\":\"Pausa: boquilla atascada\",\"check_plaform\":\"Comprobando plataforma\",\"bed_level_phase_1\":\"Nivelación de cama 1\",\"bed_level_phase_2\":\"Nivelación de cama 2\",\"bed_level_high_temperature\":\"Nivelación a alta temperatura\",\"auto_bed_leveling\":\"Nivelación automática de cama\",\"calibrating_detection_nozzle_clumping\":\"Calibrando detección de grumos\",\"calibrating_cutter_model_offset\":\"Calibrando offset del cortador\",\"scanning_bed_surface\":\"Escaneando superficie de cama\",\"inspecting_first_layer\":\"Inspeccionando primera capa\",\"hotend_type_detection\":\"Detectando tipo de hotend\",\"check_material\":\"Comprobando material\",\"check_material_position\":\"Comprobando posición del material\",\"calibrating_extrusion\":\"Calibrando extrusión\",\"calibrating_extrusion_flow\":\"Calibrando flujo\",\"paused_skipped_step\":\"Pausa: pérdida de pasos\",\"cooling_chamber\":\"Enfriando cámara\",\"check_door_and_cover\":\"Comprobando puerta y cubierta\",\"cleaning_nozzle_tip\":\"Limpiando punta de boquilla\",\"calibrating_micro_lidar\":\"Calibrando micro lidar\",\"laser_calibration\":\"Calibración láser\",\"cooling_nozzle\":\"Enfriando boquilla\",\"filament_unloading\":\"Descargando filamento\",\"active_arc_fitting\":\"Ajuste de arcos\",\"paused_ams_lost\":\"Pausa: AMS desconectado\",\"absolute_accuracy_calibration\":\"Calibración de precisión\",\"check_absolute_accuracy_before_calibration\":\"Comprobando precisión\",\"check_absolute_accuracy_after_calibration\":\"Comprobando precisión\",\"paused_user_gcode\":\"Pausa por G-code\",\"calibrate_birdeye_camera\":\"Calibrando cámara panorámica\",\"check_birdeye_camera_position\":\"Comprobando cámara panorámica\",\"pre_extrusion_before_printing\":\"Preextrusión\",\"changing_filament\":\"Cambiando filamento\",\"homing_blade_holder\":\"Posicionando soporte de cuchilla\",\"calibrating_blade_holder_position\":\"Calibrando soporte de cuchilla\",\"hotend_pick_place_test\":\"Probando cambio de hotend\",\"build_plate_alignment_detection\":\"Detectando alineación de placa\",\"identifying_build_plate_type\":\"Identificando placa de impresión\",\"measuring_surface\":\"Midiendo superficie\",\"measuring_rotary_attachment\":\"Midiendo accesorio giratorio\",\"motor_noise_showoff\":\"Comprobando ruido del motor\",\"calibrating_motor_noise\":\"Calibrando ruido del motor\",\"paused_filament_runout\":\"Pausa: filamento agotado\",\"calibrating_live_view_camera\":\"Calibrando cámara en directo\",\"calibrating_camera_offset\":\"Calibrando offset de cámara\",\"check_quick_release\":\"Comprobando cierre rápido\",\"m400_pause\":\"En pausa (M400)\",\"paused_low_fan_speed_heat_break\":\"Pausa: ventilador del heatbreak lento\",\"heatbed_surface_foreign_object_detection\":\"Buscando objetos en la cama\",\"heatbed_underside_foreign_object_detection\":\"Comprobando debajo de la cama\",\"heating_hotend\":\"Calentando el hotend\",\"paused_first_layer_error\":\"Pausa: error de primera capa\",\"moving_toolhead_to_center_of_heatbed\":\"Moviendo al centro de la cama\",\"waiting_for_heatbed_temperature\":\"Esperando temperatura de cama\",\"checking_extruder_temperature\":\"Comprobando temperatura del extrusor\",\"calibrate_nozzle_offset\":\"Calibrando offset de boquilla\",\"paused_chamber_temperature_control_error\":\"Pausa: error de temperatura de cámara\",\"waiting_chamber_temperature_equalize\":\"Esperando temperatura de cámara\",\"paused_nozzle_temperature_malfunction\":\"Pausa: error de temperatura de boquilla\",\"homing_toolhead\":\"Posicionando cabezal\",\"paused_front_cover_falling\":\"Pausa: cubierta frontal caída\",\"heated_bedcooling\":\"Enfriando cama\",\"paused_heat_bed_temperature_malfunction\":\"Pausa: error de temperatura de cama\",\"heating_chamber\":\"Calentando cámara\",\"paused_nozzle_filament_covered_detected\":\"Pausa: filamento sobre la boquilla\",\"paused_cutter_error\":\"Pausa: error del cortador\",\"purifying_chamber_air\":\"Purificando aire de la cámara\",\"heatbed_preheating\":\"Precalentando cama\",\"paused_user\":\"Pausado por el usuario\",\"thermal_preconditioning\":\"Preacondicionamiento térmico\",\"sweeping_xy_mech_mode\":\"Comprobando mecánica XY\"},\"abort_confirm\":\"Abortar impresión\"},"
    "\"autoupdate\":{\"rollback_title\":\"Actualización revertida\",\"rollback_message\":\"La actualización automática a\",\"rollback_message2\":\"falló. El panel restauró el firmware anterior y no reintentará esta versión.\"},"
    "\"todo\":{\"empty\":\"sin tareas pendientes\",\"loading\":\"cargando...\"},"
    "\"settings\":{\"wifi\":{\"ssid\":\"SSID\"}},"
    "\"boot\":{\"initializing_system\":\"Inicializando sistema\",\"initializing_wifi\":\"Inicializando Wi-Fi\",\"initializing_touch\":\"Inicializando tactil\",\"wifi_setup_title\":\"Configuracion Wi-Fi\",\"wifi_connect_failed\":\"Error de conexion Wi-Fi\",\"wifi_credentials_missing\":\"Faltan credenciales Wi-Fi\",\"open_editor\":\"Abrir BETTA Editor:\",\"ha_setup_title\":\"Configuracion Home Assistant\",\"wifi_connected\":\"Wi-Fi conectado\",\"ha_credentials_missing\":\"Faltan credenciales HA\",\"set_ha_url_token\":\"Configurar URL y token de HA\",\"loading_dashboard\":\"Cargando panel\",\"setup_ap_prefix\":\"AP de setup\",\"setup_ap_password\":\"Contrasena\",\"offline_mode\":\"Modo sin conexion\",\"wifi_unreachable\":\"Wi-Fi no accesible\",\"wifi_auto_reconnect\":\"Se reconectará automáticamente cuando vuelva\",\"wifi_or_setup\":\"O configura de nuevo, AP:\"},"
    "\"xiaozhi\":{\"title\":\"AI Assistant\",\"talk\":\"Mantener para hablar\",\"state\":{\"disabled\":\"Desactivado\",\"ready\":\"Listo\",\"connecting\":\"Conectando\",\"listening\":\"Escuchando\",\"waiting\":\"Esperando respuesta\",\"speaking\":\"Hablando\",\"speaking_listening\":\"Hablando y escuchando\",\"pairing\":\"Empareja en xiaozhi.me con el código\",\"pairing_retry\":\"Servicio no disponible; reintentando\",\"pairing_error\":\"Error de emparejamiento\",\"pairing_expired\":\"Emparejamiento caducado; inténtalo de nuevo\",\"pair_first\":\"Empareja primero el dispositivo\",\"connection_error\":\"Conexión interrumpida; inténtalo de nuevo\",\"audio_or_connection_error\":\"Audio o conexión no disponibles\",\"storage_error\":\"No se pudo guardar la configuración\",\"memory_error\":\"Memoria insuficiente\",\"unsupported\":\"Esta placa no admite audio de voz\",\"wake_error\":\"Activación por voz no disponible; usa el botón de hablar\"},\"wake\":\"Activación por voz\",\"wake_hint\":\"Di «Ni hao Xiao Zhi» para empezar. La palabra de activación se reconoce localmente.\",\"timeout\":\"La conversación termina al despedirse o tras 30 segundos sin voz ni reproducción.\",\"recognized\":\"Voz reconocida\",\"reply\":\"Respuesta de IA\",\"privacy\":\"Desactivado por defecto. La detección opcional de activación es local. Tras activarlo por voz o pulsar Hablar, el audio se envía al servicio de voz vinculado. La vinculación comparte la identidad del dispositivo.\",\"emoji_style\":\"Estilo de emociones de IA\",\"emoji_otto\":\"Robot Otto\",\"emoji_classic\":\"Emojis clásicos\",\"you\":\"Tú\",\"assistant\":\"AI Assistant\",\"hint_duplex\":\"Estoy hablando y escuchando\",\"hint_listening\":\"Adelante, te escucho\",\"hint_thinking\":\"Un momento\",\"hint_ready\":\"Di la palabra de activación para iniciar una conversación\",\"hint_error\":\"Vuelve a activarme para intentarlo de nuevo\",\"hint_timeout\":\"Volver al inicio en %u s · Habla para continuar\",\"hint_manual_error\":\"Mantén pulsado para hablar e intentarlo de nuevo\",\"hint_timeout_manual\":\"Volver al inicio en %u s · Mantén pulsado para hablar\"},"
    "\"ota\":{\"title\":\"Actualización de firmware\",\"preparing\":\"Preparando actualización\",\"downloading\":\"Descargando firmware...\",\"receiving\":\"Recibiendo firmware...\",\"writing\":\"Escribiendo firmware\",\"success\":\"Actualización guardada. Reiniciando...\",\"failed\":\"Actualización fallida. Consulte el editor.\",\"writing_version\":\"Escribiendo firmware %s\",\"unknown_size\":\"%s / desconocido\"},"
    "\"titles\":{\"car\":\"Coche\",\"solar\":\"Previsión solar\",\"sonos\":\"Favoritos de Sonos\",\"printer\":\"Impresora Bambu\"},"
    "\"screen\":{\"title\":\"Ajustes del sistema\",\"active\":\"Brillo\",\"dim\":\"Brillo atenuado\",\"dim_seconds\":\"Atenuar tras (segundos)\",\"mode\":\"Tras inactividad\",\"start_minutes\":\"Iniciar tras (minutos)\",\"clock_start\":\"Mostrar reloj tras (segundos)\",\"clock_brightness\":\"Brillo del reloj\",\"clock_off\":\"Apagar después del reloj\",\"clock_off_seconds\":\"Mostrar reloj durante (segundos)\",\"clock_24h\":\"Reloj de 24 horas\",\"clock_seconds\":\"Mostrar segundos\",\"clock_date\":\"Mostrar fecha\",\"disabled\":\"Desactivado\",\"clock\":\"Reloj\",\"off\":\"Apagar pantalla\",\"weather\":\"Tiempo\",\"pages\":\"Alternar páginas\",\"cancel\":\"Cancelar\",\"save\":\"Guardar\",\"hint\":\"Los cambios se aplican al guardar.\",\"saving\":\"Guardando...\",\"failed\":\"No se pudo guardar. Inténtalo de nuevo.\",\"load_failed\":\"Ajustes no disponibles. Cierra e inténtalo de nuevo.\",\"preview\":\"Vista previa (30 s)\",\"clock_analog\":\"Reloj analógico\",\"clock_style\":\"Estilo de reloj\",\"clock_digital\":\"Reloj digital\",\"clock_flip\":\"Reloj de paletas\",\"rotation\":\"Rotación de pantalla\",\"auto_rotation\":\"Rotación automática\",\"xiaozhi_emoji\":\"Estilo de emociones de IA\"},"
    "\"system\":{\"language\":\"Idioma\",\"timezone\":\"Zona horaria\",\"appearance\":\"Apariencia\",\"theme\":\"Tema de color\",\"flat\":\"Plano\",\"glow\":\"Brillo\",\"glass\":\"Cristal\",\"matte\":\"Mate\",\"dark_v2\":\"Oscuro\",\"classic_v1\":\"Clásico\",\"light\":\"Claro\",\"ocean\":\"Océano\",\"contrast\":\"Alto contraste\",\"black\":\"Negro puro\",\"page_animations\":\"Animaciones de página\",\"on\":\"Activado\",\"off\":\"Desactivado\"},"
    "\"alerts\":{\"title\":\"Alertas\",\"empty\":\"Sin alertas\",\"unknown\":\"Desconocido\",\"crash\":\"Informe de fallo guardado\",\"ppa\":\"Tiempo de espera del acelerador gráfico agotado\",\"lvgl\":\"Tarea de pantalla bloqueada\",\"runtime\":\"Tarea de interfaz bloqueada\",\"time\":\"Hora\",\"task\":\"Tarea\",\"reason\":\"Motivo\",\"version\":\"Versión\",\"build\":\"Compilación\",\"retained\":\"Informe histórico; no indica necesariamente un fallo actual. Descárguelo o elimínelo en Ajustes web > Dispositivo.\",\"wifi\":\"Wi-Fi desconectado\",\"wifi_detail\":\"El panel no puede conectarse a Wi-Fi. Revise el punto de acceso y la configuración de red. La reconexión es automática.\",\"ha\":\"Home Assistant desconectado\",\"ha_detail\":\"Los datos pueden estar desactualizados. Revise Home Assistant y la conexión en los ajustes web.\",\"mqtt\":\"MQTT desconectado\",\"mqtt_detail\":\"Las notificaciones MQTT no están disponibles. Revise el servidor y los ajustes MQTT. La reconexión es automática.\",\"entity\":\"Entidad\",\"state\":\"Estado\",\"sensor\":\"Alerta de sensor / timbre\"},"
    "\"price\":{\"today\":\"Hoy\",\"tomorrow\":\"Mañana\",\"min\":\"min\",\"max\":\"máx.\",\"average\":\"Media\",\"cheap\":\"Económico\",\"no_cheap\":\"No quedan franjas económicas\",\"no_data\":\"Sin precios\",\"no_today\":\"Sin precios para hoy\",\"no_tomorrow\":\"Mañana aún no publicado\",\"no_clock\":\"Sin hora\"},"
    "\"parqet\":{\"xirr\":\"XIRR\",\"ttwror\":\"TTWROR\",\"dividends\":\"Dividendos\",\"realized\":\"Realizadas\",\"performance\":\"Rendimiento\",\"holdings\":\"Posiciones\",\"loading\":\"Cargando\",\"no_answer\":\"Sin respuesta (puede ser demasiado grande)\",\"failed\":\"No disponible\",\"no_data\":\"Sin datos\",\"largest\":\"Principales\",\"top\":\"5 mejores\",\"flop\":\"5 peores\",\"pick_interval\":\"Elige un periodo\",\"unit_mismatch\":\"Unidad distinta\",\"period\":{\"1d\":\"1D\",\"1w\":\"1S\",\"1m\":\"1M\",\"ytd\":\"Año\",\"max\":\"MÁX\"}},"
    "\"stock\":{\"title\":\"Acciones y ETF\",\"lookup_failed\":\"Fuente desconocida\",\"unsupported\":\"No es una cotización\",\"period\":{\"1d\":\"1D\",\"1w\":\"1S\",\"30d\":\"1M\",\"ytd\":\"YTD\",\"1y\":\"1A\"},\"source\":{\"closes\":\"Cierres\",\"recorded\":\"Registrado\",\"averages\":\"Medias de HA\"},\"since\":\"desde\",\"from\":\"desde\",\"prev_close\":\"cierre ant.\",\"trend\":\"tendencia\",\"history_failed\":\"Historial no disponible\",\"history_empty\":\"Sin historial para este periodo\",\"market\":{\"open\":\"Mercado abierto\",\"pre\":\"Preapertura\",\"post\":\"Después del cierre\",\"closed\":\"Mercado cerrado\"},\"updated\":\"actualizado\",\"last_price\":\"último precio\",\"start\":\"Inicio\"},"
    "\"air\":{\"title\":\"Calidad del aire\",\"humidity\":\"Humedad\",\"humidity_short\":\"Humedad\",\"temperature\":\"Temperatura\",\"temperature_short\":\"Temp.\",\"co2\":\"CO₂\",\"pm25\":\"PM2.5\",\"voc\":\"COV\",\"out_temperature\":\"Temperatura exterior\",\"out_temperature_short\":\"Temp. ext.\",\"out_humidity\":\"Humedad exterior\",\"window\":\"Contacto de ventana\",\"rating\":\"Valoración del dispositivo\",\"good\":\"Buena\",\"fair\":\"Aceptable\",\"poor\":\"Mala\",\"not_evaluated\":\"Sin evaluar\",\"partial\":\"Datos parciales\",\"dry\":\"Humedad baja\",\"humid\":\"Humedad alta · comprobar ventilación\",\"fresh_air\":\"Renovar aire · CO₂ elevado\",\"particles\":\"Partículas elevadas · reducir fuentes / filtrar; calidad exterior desconocida\",\"drying\":\"El aire de referencia puede secar la habitación\",\"no_drying\":\"El aire de referencia no aporta suficiente secado\",\"conflict\":\"Hay que renovar el aire; el aire de referencia añadiría humedad\",\"conflict_short\":\"Renovar aire · conflicto de humedad\",\"co2_short\":\"Ventilar · CO₂ elevado\",\"humid_short\":\"Humedad alta\",\"pm_short\":\"Partículas elevadas\",\"humidity_scope\":\"Solo humedad\",\"no_advice\":\"Datos evaluados insuficientes para aconsejar\",\"absolute\":\"Humedad absoluta: interior / exterior\",\"weather_reference\":\"Referencia meteorológica; no es una medición exterior local. Antigüedad desconocida.\",\"open\":\"Abierta\",\"closed\":\"Cerrada\",\"enum_extremely_poor\":\"Extremadamente mala\",\"enum_very_poor\":\"Muy mala\",\"enum_poor\":\"Mala\",\"enum_fair\":\"Aceptable\",\"enum_good\":\"Buena\",\"enum_moderate\":\"Moderada\",\"choose_humidity\":\"Elegir sensor de humedad\",\"blank\":\"Widget vacío de calidad del aire\",\"outdoor_enabled\":\"Comparar con el exterior\",\"sources_hint\":\"La humedad es obligatoria. Asigne las demás funciones explícitamente. COV solo se muestra; la valoración del dispositivo no cambia el estado BETTA. Elija temperatura y humedad exterior como pareja.\",\"invalid_binding\":\"Entidad no válida para {role}.\"},"
    "\"network\":{\"ethernet\":\"Ethernet\",\"interface\":\"Conexión\"}"
    "}}";
