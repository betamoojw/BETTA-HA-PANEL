/* SPDX-License-Identifier: LicenseRef-FNCL-1.1
 * Copyright (c) 2026 andre68723
 * Generated by tools/generate_i18n.py; edit the JSON catalog.
 */
static const char I18N_BUILTIN_FR[] =
    "{\"lvgl\":{"
    "\"common\":{\"on\":\"ACTIF\",\"off\":\"ARRÊT\",\"unavailable\":\"indisponible\",\"paused\":\"en pause\",\"playing\":\"lecture\",\"start\":\"Démarrer\",\"pause\":\"Pause\",\"unknown\":\"Inconnu\"},"
    "\"cover\":{\"open\":\"Ouvert\",\"closed\":\"Fermé\",\"opening\":\"Ouverture\",\"closing\":\"Fermeture\",\"moving\":\"En mouvement\"},"
    "\"datetime\":{\"date\":\"Date\",\"time\":\"Temps\",\"save\":\"Enregistrer\",\"cancel\":\"Annuler\",\"invalid\":\"Date ou heure invalide\",\"failed\":\"Impossible d'enregistrer\"},"
    "\"history\":{\"loading\":\"Chargement de l'historique...\",\"empty\":\"Aucun historique enregistré\",\"shortened\":\"Historique raccourci pour tenir\",\"error\":\"Impossible de charger l'historique\",\"min\":\"Min\",\"max\":\"Max\",\"range_day\":\"24 h\",\"range_week\":\"7 jours\",\"hourly_mean\":\"Moyennes horaires\",\"week_empty\":\"Aucune statistique des 7 derniers jours\",\"week_error\":\"Impossible de charger les statistiques\",\"days_total\":\"7 derniers jours\",\"days_title\":\"Consommation quotidienne\",\"days_partial\":\"Barres claires : journée incomplète\",\"days_sources\":\"Certaines sources manquent\",\"days_unsupported\":\"Aucune statistique pour cette source\",\"range_30d\":\"30 j\",\"range_12m\":\"12 mois\",\"daily_mean\":\"Moyennes journalières\",\"weekly_mean\":\"Moyennes hebdomadaires\",\"range_empty_30d\":\"Pas encore de statistiques sur 30 jours\",\"range_empty_12m\":\"Pas encore de statistiques sur 12 mois\",\"days_production\":\"Production journalière\"},"
    "\"energytl\":{\"home\":\"Consommation du logement\",\"solar\":\"Du solaire\",\"grid\":\"Du réseau\",\"export\":\"Injection réseau\",\"battery\":\"De la batterie\",\"home_s\":\"Maison\",\"export_s\":\"Injection réseau\",\"solar_s\":\"Solaire\",\"battery_s\":\"Batterie\",\"c_solar\":\"Solaire\",\"c_battery\":\"Batterie\",\"c_grid\":\"Reseau\",\"c_export\":\"Injection réseau\",\"c_charge\":\"En charge\",\"c_forecast\":\"Prévisions\",\"loading\":\"Chargement ...\",\"stale\":\"Périmé\",\"nostats\":\"Aucune statistique\",\"nostats_hint\":\"Home Assistant n'a pas de statistiques à long terme du compteur d'importation réseau. Il nécessite state_class total ou total_increasing.\",\"updated\":\"Actualisé %s\",\"partial\":\"%d créneaux sur %d incomplets\",\"measured\":\"Mesuré, dernières 24 heures\",\"import\":\"Importation réseau\",\"export_meter\":\"Exportation réseau\",\"solar_meter\":\"Production solaire\",\"charge\":\"Charge de la batterie\",\"discharge\":\"Décharge de la batterie\",\"soc\":\"Niveau de batterie\",\"forecast\":\"Prévisions solaires\",\"mix_estimated\":\"Mix (estimé)\",\"mix\":\"Mix\",\"home_from_solar\":\"  du solaire\",\"home_from_battery\":\"  de la batterie\",\"home_from_grid\":\"  du réseau\",\"export_from_solar\":\"  du solaire\",\"export_from_battery\":\"  de la batterie\",\"charge_from_solar\":\"  du solaire\",\"charge_from_grid\":\"  du réseau\",\"estimate_note\":\"Estimation : les compteurs agrégés ne distinguent pas si le réseau a chargé la batterie ou alimenté le logement. Le solaire alimente d'abord le logement, puis la batterie, puis le réseau ; la batterie couvre le besoin restant. Les valeurs mesurées ci-dessus sont exactes.\"},"
    "\"room\":{\"switches_off\":\"Interrupteurs éteints\",\"switch_on\":\"Interrupteur allumé\",\"switches_on_n\":\"%d interrupteurs allumés\",\"idle\":\"Pret\",\"closed\":\"Fermé\",\"open_n\":\"%d ouverts\",\"lights_off\":\"Lumières éteintes\",\"light_on\":\"Lumière allumée\",\"lights_on_n\":\"%d lumières allumées\",\"present\":\"Présent\",\"empty\":\"Vide\",\"battery_n\":\"%d batteries faibles\"},"
    "\"binary\":{\"just_now\":\"a l'instant\",\"ringing\":\"Déclenché\",\"last\":\"Dernier\",\"no_event\":\"Aucun événement\",\"home\":\"Maison\",\"away\":\"Absent\",\"motion\":\"Mouvement\",\"clear\":\"Dégagé\",\"unlocked\":\"Déverrouillé\",\"locked\":\"Verrouillé\",\"wet\":\"Mouillé\",\"dry\":\"Sec\",\"alarm\":\"Alarme\",\"ok\":\"OK\",\"low\":\"Faible\",\"connected\":\"Connecte\",\"disconnected\":\"Déconnecté\",\"on\":\"Marche\",\"off\":\"Arrêt\"},"
    "\"scene\":{\"scene\":\"Scène\",\"script\":\"Script\",\"button\":\"Bouton\",\"lock\":\"Déverrouiller\"},"
    "\"lock\":{\"state\":{\"locked\":\"Verrouillé\",\"unlocked\":\"Déverrouillé\",\"locking\":\"Verrouillage ...\",\"unlocking\":\"Déverrouillage ...\",\"open\":\"Ouvert\",\"opening\":\"Ouverture ...\",\"jammed\":\"Bloqué\"},\"lock\":\"Serrure\",\"unlock\":\"Déverrouiller\",\"open\":\"Ouvert\",\"confirm_unlock\":\"Déverrouiller %s ?\",\"confirm_open\":\"Ouvrir %s ?\"},"
    "\"alarm\":{\"state\":{\"disarmed\":\"Désarmé\",\"armed_home\":\"Armé à domicile\",\"armed_away\":\"Armé en absence\",\"armed_night\":\"Armé la nuit\",\"armed_vacation\":\"Armé en vacances\",\"armed_custom_bypass\":\"Armé personnalisé\",\"arming\":\"Armement ...\",\"pending\":\"En attente\",\"disarming\":\"Désarmement ...\",\"triggered\":\"Déclenché\"},\"action\":{\"disarm\":\"Désarmer\",\"arm_home\":\"Armer à domicile\",\"arm_away\":\"Armer en absence\",\"arm_night\":\"Armer la nuit\",\"arm_vacation\":\"Armer en vacances\",\"arm_custom_bypass\":\"Armer avec exclusion personnalisée\"},\"ok\":\"OK\",\"zones\":\"Zones\",\"controls\":\"Commandes\",\"history\":\"Historique\",\"refresh\":\"Actualiser\",\"hold\":\"Maintenir 2 s\",\"enter_code\":\"Saisir le code\",\"no_code\":\"Aucun code requis\",\"text_code\":\"Code texte : utiliser Home Assistant\",\"btn\":{\"disarm\":\"Désarmer\",\"away\":\"Armer absent\",\"home\":\"Armer présent\",\"night\":\"Armer nuit\",\"vacation\":\"Vacances\"},\"msg\":{\"sent\":\"Demande en attente\",\"failed\":\"Échec de la demande\",\"accepted\":\"Demande acceptée\",\"rejected\":\"Demande échouée ou refusée\",\"enter_code\":\"Saisissez d’abord le code\"},\"log\":{\"loading\":\"Chargement…\",\"failed\":\"Historique indisponible\",\"empty\":\"Aucun événement\",\"no_clock\":\"Synchronisation de l’heure\"},\"pressed\":\"Appuyé\",\"zone\":{\"detected\":\"Détecté\",\"ok\":\"OK\",\"motion\":\"Mouvement\",\"clear\":\"Libre\",\"open\":\"Ouvert\",\"closed\":\"Fermé\",\"active\":\"Actif\",\"inactive\":\"Inactif\",\"not_ready\":\"Non prêt\"},\"zones_active\":\"zones actives\",\"zones_ready\":\"Toutes les zones libres\"},"
    "\"vacmode\":{\"vacuum\":\"Aspirateur\",\"mop\":\"Laver\",\"vac_and_mop\":\"Aspirer et laver\",\"vacuum_and_mop\":\"Aspirer et laver\",\"mop_after_vac\":\"Aspirer puis laver\",\"mop_after_vacuum\":\"Aspirer puis laver\",\"quick_vac\":\"Aspiration rapide\",\"auto_vac\":\"Aspiration automatique\",\"deep_clean_vac\":\"Aspiration approfondie\",\"quiet_vac\":\"Aspiration silencieuse\",\"quick_mop\":\"Lavage rapide\",\"auto_mop\":\"Lavage automatique\",\"deep_clean_mop\":\"Lavage approfondi\",\"quick_vac_and_mop\":\"Aspiration et lavage rapides\",\"auto_vac_and_mop\":\"Aspiration et lavage automatiques\",\"deep_clean_vac_and_mop\":\"Aspiration et lavage approfondis\",\"quiet_vac_and_mop\":\"Aspiration et lavage silencieux\",\"custom\":\"Personnalisé\"},"
    "\"car\":{\"precond\":\"Précond.\",\"precond_pending\":\"Envoi...\"},"
    "\"fan\":{\"oscillate\":\"Osciller\"},"
    "\"contact\":{\"open\":\"Ouvert\",\"opened\":\"Ouvert\",\"closed\":\"Fermé\"},"
    "\"climate\":{\"current\":\"Maintenant\",\"fan_short\":\"Ventilateur\",\"fan_title\":\"Mode de ventilation\",\"mode_title\":\"Mode\",\"swing_short\":\"Oscillation\",\"swing_title\":\"Mode d'oscillation\",\"mode\":{\"off\":\"Arrêt\",\"heat\":\"Chauffage\",\"cool\":\"Froid\",\"auto\":\"Auto\",\"dry\":\"Sec\",\"fan_only\":\"Ventilation seule\",\"heat_cool\":\"Chaud/Froid\",\"cooling\":\"Refroidissement\",\"drying\":\"Séchage\",\"idle\":\"Pret\",\"fan\":\"Ventilateur\",\"defrosting\":\"Dégivrage\",\"preheating\":\"Préchauffage\",\"vertical\":\"Vertical\",\"horizontal\":\"Horizontal\",\"both\":\"Les deux\"}},"
    "\"roborock\":{\"fan_title\":\"Niveau d'aspiration\",\"ready\":\"Prêt\",\"cleaning\":\"Nettoyage\",\"returning\":\"Retour\",\"dock\":\"Station\",\"fan\":\"Ventilateur\",\"clean_selected_short\":\"Nettoyer\",\"map_ready\":\"Carte connectée\",\"map_loading\":\"Chargement de la carte\",\"map_waiting\":\"En attente de la carte\",\"map_failed\":\"Aperçu de carte indisponible\",\"ready_to_charge\":\"À la station\",\"mode\":\"Mode\",\"mode_title\":\"Mode de nettoyage\",\"send_failed\":\"Commande non envoyée\",\"not_connected\":\"Home Assistant non connecté\",\"state\":{\"cleaning\":\"Nettoyage\",\"docked\":\"Sur la base\",\"returning\":\"Retour\",\"idle\":\"Pret\",\"paused\":\"En pause\",\"error\":\"Erreur\",\"unavailable\":\"Indisponible\",\"unknown\":\"Inconnu\",\"segment_cleaning\":\"Nettoyage de pièce\",\"room_cleaning\":\"Nettoyage de pièce\",\"zoned_cleaning\":\"Nettoyage de zone\",\"spot_cleaning\":\"Nettoyage localisé\",\"going_to_target\":\"Déplacement vers la cible\",\"target_found\":\"Cible atteinte\"}},"
    "\"topbar\":{\"ha\":\"HA\",\"ap\":\"AP\"},"
    "\"sensor\":{\"age\":{\"just_now\":\"a l'instant\",\"min_one\":\"il y a 1 min\",\"min_many\":\"il y a %d min\",\"hour_one\":\"il y a 1 h\",\"hour_many\":\"il y a %d h\",\"day_one\":\"il y a 1 jour\",\"day_many\":\"il y a %d jours\"},\"in\":{\"now\":\"maintenant\",\"min_one\":\"dans 1 min\",\"min_many\":\"dans %d min\",\"hour_one\":\"dans 1 heure\",\"hour_many\":\"dans %d heures\",\"day_one\":\"dans 1 jour\",\"day_many\":\"dans %d jours\"},\"day\":{\"today\":\"aujourd’hui\",\"tomorrow\":\"demain\",\"yesterday\":\"hier\"},\"dur\":{\"d\":\"j\",\"h\":\"h\",\"min\":\"min\",\"s\":\"s\"}},"
    "\"heating\":{\"target_format\":\"Cible %.1f°C\",\"active\":\"chauffage actif\"},"
    "\"light\":{\"effect\":\"Effet\",\"color_title\":\"Couleur lumiere\",\"white\":\"Blanc\",\"color_temperature\":\"Temperature couleur\",\"warm\":\"Chaud\",\"cool\":\"Froid\",\"rgb_color\":\"Couleur RGB\",\"presets\":\"Prereglages\",\"hue\":\"Teinte\",\"saturation\":\"Saturation\"},"
    "\"weather\":{\"unavailable\":\"Indisponible\",\"humidity_format\":\"Humidite %d%%\",\"low_short\":\"Minimum\",\"rain_short\":\"Pluie\",\"now\":\"Maintenant\",\"today\":\"Aujourd'hui\",\"report_title\":\"Bulletin météo\",\"day_full_0\":\"Dimanche\",\"day_full_1\":\"Lundi\",\"day_full_2\":\"Mardi\",\"day_full_3\":\"Mercredi\",\"day_full_4\":\"Jeudi\",\"day_full_5\":\"Vendredi\",\"day_full_6\":\"Samedi\",\"pressure\":\"Pression\",\"wind_gust\":\"Rafales\",\"uv_index\":\"Indice UV\",\"cloud_cover\":\"Couverture nuageuse\",\"sunshine\":\"Ensoleillement\",\"rain_duration\":\"Durée de pluie\",\"dew_point\":\"Point de rosée\",\"humidity\":\"Humidité\",\"wind\":\"Vent\",\"visibility\":\"Visibilité\",\"rain_chance\":\"Probabilité de pluie\",\"precipitation\":\"Précipitations\",\"compass\":\"N,NE,E,SE,S,SO,O,NO\",\"weekday_0\":\"Dim\",\"weekday_1\":\"Lun\",\"weekday_2\":\"Mar\",\"weekday_3\":\"Mer\",\"weekday_4\":\"Jeu\",\"weekday_5\":\"Ven\",\"weekday_6\":\"Sam\",\"condition\":{\"clear_night\":\"Nuit claire\",\"cloudy\":\"Nuageux\",\"exceptional\":\"Exceptionnel\",\"fog\":\"Brouillard\",\"hail\":\"Grêle\",\"lightning\":\"Éclairs\",\"lightning_rainy\":\"Éclairs et pluie\",\"partlycloudy\":\"Partiellement nuageux\",\"pouring\":\"Pluie intense\",\"rainy\":\"Pluvieux\",\"snowy\":\"Neigeux\",\"snowy_rainy\":\"Neige et pluie\",\"sunny\":\"Ensoleillé\",\"windy\":\"Venteux\",\"windy_variant\":\"Venteux et nuageux\"},\"hourly_empty\":\"Aucune prévision horaire\",\"hourly_loading\":\"Chargement des prévisions horaires…\",\"view_days\":\"Jours\"},"
    "\"graph\":{\"no_history\":\"aucun historique\",\"no_data\":\"aucune donnee\",\"min\":\"min\",\"max\":\"max\"},"
    "\"notification\":{\"dismiss\":\"Fermer\",\"action\":\"Ouvert\",\"sent\":\"Envoyé\"},"
    "\"conn\":{\"wifi\":\"Wi-Fi\",\"ha\":\"Home Assistant\",\"mqtt\":\"MQTT\",\"status\":\"État\",\"host\":\"Hôte\",\"broker\":\"Courtier\",\"device_id\":\"Identifiant de l'appareil\",\"connected\":\"Connecte\",\"disconnected\":\"Non connecté\",\"syncing\":\"Connecté, synchronisation\",\"disabled\":\"Désactivé\",\"diag_reason\":\"Cause de la dernière déconnexion\",\"diag_reconnects\":\"Tentatives de reconnexion\",\"diag_hard_recover\":\"Récupération complète C6\",\"firmware\":\"Micrologiciel\",\"version\":\"Version\",\"built\":\"Compilé\",\"update_available\":\"Mise à jour disponible\",\"reconnect\":\"Reconnecter\",\"reconnecting\":\"Reconnexion…\",\"retry_hint\":\"Rétablissez l’accès ou supprimez le blocage IP dans Home Assistant avant de reconnecter.\",\"access\":\"Accès\",\"forbidden\":\"Refusé (HTTP 403) ; vérifier les blocages IP HA\",\"token_rejected\":\"Jeton d’accès refusé\",\"no_rejection\":\"Aucun refus signalé\"},"
    "\"wifi\":{\"info\":{\"ip\":\"Adresse IP\",\"signal\":\"Puissance du signal\",\"setup_ap\":\"Point d'accès de configuration actif\",\"signal_excellent\":\"Excellent\",\"signal_good\":\"Bon\",\"signal_fair\":\"Moyen\",\"signal_weak\":\"Faible\"}},"
    "\"solar\":{\"rest\":\"Reste\",\"today\":\"Aujourd'hui\",\"tomorrow\":\"Demain\",\"day_3\":\"Jour 3\",\"day_4\":\"Jour 4\",\"day_5\":\"Jour 5\",\"day_generic\":\"Jour\",\"weekday_0\":\"Di\",\"weekday_1\":\"Lu\",\"weekday_2\":\"Ma\",\"weekday_3\":\"Me\",\"weekday_4\":\"Je\",\"weekday_5\":\"Ve\",\"weekday_6\":\"Sa\",\"details_title\":\"Prévision solaire du jour\",\"remaining\":\"Restant\",\"total\":\"Total\",\"day_6\":\"Jour 6\",\"day_7\":\"Jour 7\"},"
    "\"energy\":{\"title\":\"Énergie\",\"waiting\":\"En attente d'énergie\",\"ha_waiting\":\"Énergie HA\",\"today\":\"Aujourd'hui\",\"grid\":\"Réseau\",\"solar\":\"Solaire\",\"home\":\"Maison\",\"battery\":\"Batterie\",\"grid_in\":\"import\",\"grid_out\":\"export\",\"battery_charge\":\"charge\",\"battery_out\":\"export\",\"home_now\":\"Conso.\",\"water\":\"Eau\",\"gas\":\"Gaz\",\"autarky\":\"Autonomie\",\"details_prompt\":\"Choisir Gaz, Eau ou Solaire\"},"
    "\"sonos_favorites\":{\"sensor_hint\":\"Nécessite HA Sonos et le capteur de favoris activé.\",\"setup_hint\":\"Activez Sonos et sensor.sonos_favorites dans Home Assistant.\",\"empty\":\"Aucun favori.\"},"
    "\"evcc\":{\"wallbox\":\"Borne de recharge\",\"add\":\"+ Borne (evcc)\",\"loadpoint\":\"Point de charge\",\"choose\":\"Choisir un point de charge\",\"find\":\"Rechercher les points de charge\",\"finding\":\"Recherche des points de charge...\",\"failed\":\"Non confirmé\",\"none_found\":\"Aucun point de charge evcc activé trouvé\",\"replace\":\"Remplacer les entités existantes par celles de ce point de charge ? Les affectations manuelles seront remplacées.\",\"missing\":\"Entités absentes ou désactivées\",\"bound\":\"Point de charge configuré\",\"entities\":\"Entités avancées\",\"hint\":\"Les entités absentes doivent être activées dans Home Assistant. Une nouvelle détection conserve les affectations manuelles.\",\"mode\":\"Mode de charge\",\"vehicle\":\"Véhicule\",\"target\":\"Charge cible\",\"power\":\"Puissance de charge (capteur)\",\"soc\":\"Charge du véhicule (capteur)\",\"connected\":\"Connecte\",\"charging\":\"En charge\",\"disabled\":\"Désactivé dans la configuration (binary_sensor)\",\"effective\":\"Effectif\",\"off\":\"Arrêt\",\"smart\":\"Intelligent\",\"fast\":\"Rapide\",\"none\":\"Aucun véhicule\",\"ready\":\"Non connecté\",\"unavailable\":\"Indisponible\",\"pending\":\"En attente...\",\"apply\":\"Appliquer\",\"energy\":\"Énergie chargée (capteur)\",\"remaining\":\"Restant\",\"sessions\":\"Sessions\",\"charged\":\"Chargé\",\"change\":\"Changer\",\"last\":\"Dernière session\",\"power_label\":\"Puissance\",\"soc_label\":\"SOC\",\"target_label\":\"Charge cible\",\"car\":\"Véhicule\",\"start\":\"Démarrer\",\"sessions_loading\":\"Chargement des sessions...\",\"sessions_error\":\"Impossible de charger les sessions\",\"sessions_empty\":\"Aucune session terminée\",\"sessions_unsupported\":\"Sessions indisponibles\",\"sessions_preview\":\"Sessions disponibles sur le panneau\",\"header_power\":\"Puissance de charge\",\"flow_pv\":\"PV\",\"flow_battery\":\"Batterie\",\"flow_grid\":\"Réseau\",\"flow_home\":\"Maison\",\"flow_car\":\"Voiture\",\"flow_export\":\"Injection réseau\",\"guest\":\"Véhicule invité\"},"
    "\"camera\":{\"live\":\"Caméra en direct\",\"connecting\":\"Connexion...\",\"paused\":\"En pause\",\"waiting\":\"En attente de la caméra\",\"unsupported\":\"MJPEG indisponible\",\"failed\":\"Connexion caméra perdue\",\"snapshot_failed\":\"Image indisponible\"},"
    "\"bambu\":{\"state\":{\"missing\":\"Aucune donnée\",\"unavailable\":\"Indisponible\",\"other\":\"Inconnu\",\"offline\":\"Hors ligne\",\"idle\":\"Pret\",\"init\":\"Démarrage\",\"prepare\":\"Préparation\",\"slicing\":\"Découpage\",\"running\":\"Impression\",\"pause\":\"En pause\",\"finish\":\"Terminé\",\"failed\":\"Échec\"},\"pause\":\"Pause\",\"resume\":\"Reprendre\",\"stop\":\"Arrêter\",\"status\":\"État\",\"nozzle\":\"Buse\",\"bed\":\"Lit\",\"progress\":\"Progression\",\"remaining\":\"Restant\",\"min\":\"min\",\"stage\":\"Étape\",\"job\":\"Travail\",\"stop_title\":\"Arrêter cette impression ?\",\"cancel\":\"Annuler\",\"not_confirmed\":\"Commande non confirmée\",\"send_failed\":\"Impossible d'envoyer la commande\",\"sending\":\"Envoi...\",\"last_job\":\"Dernier travail\",\"details\":\"État de l'imprimante\",\"not_connected\":\"Home Assistant non connecté\",\"step\":{\"filament_loading\":\"Chargement du filament\",\"print_calibration_lines\":\"Impression des lignes de calibrage\",\"preparing_ams\":\"Préparation de l’AMS\",\"preparing_hotend\":\"Préparation de la tête d’extrusion\",\"moving_toolhead_above_purge_chute\":\"Déplacement vers la chute de purge\",\"paused_nozzle_clog\":\"Pause : buse bouchée\",\"check_plaform\":\"Vérification du plateau\",\"bed_level_phase_1\":\"Nivellement du plateau 1\",\"bed_level_phase_2\":\"Nivellement du plateau 2\",\"bed_level_high_temperature\":\"Nivellement à haute température\",\"auto_bed_leveling\":\"Nivellement automatique du plateau\",\"calibrating_detection_nozzle_clumping\":\"Calibrage de détection d’amas\",\"calibrating_cutter_model_offset\":\"Calibrage du décalage du coupe-fil\",\"scanning_bed_surface\":\"Scan de la surface du plateau\",\"inspecting_first_layer\":\"Inspection de la première couche\",\"hotend_type_detection\":\"Détection du type de tête\",\"check_material\":\"Vérification du matériau\",\"check_material_position\":\"Vérification de position du matériau\",\"calibrating_extrusion\":\"Calibrage de l’extrusion\",\"calibrating_extrusion_flow\":\"Calibrage du débit\",\"paused_skipped_step\":\"Pause : perte de pas\",\"cooling_chamber\":\"Refroidissement de l’enceinte\",\"check_door_and_cover\":\"Vérification de la porte et du capot\",\"cleaning_nozzle_tip\":\"Nettoyage de la pointe de buse\",\"calibrating_micro_lidar\":\"Calibrage du micro-lidar\",\"laser_calibration\":\"Calibrage laser\",\"cooling_nozzle\":\"Refroidissement de la buse\",\"filament_unloading\":\"Déchargement du filament\",\"active_arc_fitting\":\"Ajustement d’arcs\",\"paused_ams_lost\":\"Pause : AMS déconnecté\",\"absolute_accuracy_calibration\":\"Calibrage de précision\",\"check_absolute_accuracy_before_calibration\":\"Vérification de précision\",\"check_absolute_accuracy_after_calibration\":\"Vérification de précision\",\"paused_user_gcode\":\"Pause par G-code\",\"calibrate_birdeye_camera\":\"Calibrage de la caméra d’ensemble\",\"check_birdeye_camera_position\":\"Vérification de la caméra d’ensemble\",\"pre_extrusion_before_printing\":\"Pré-extrusion\",\"changing_filament\":\"Changement du filament\",\"homing_blade_holder\":\"Retour à l’origine du porte-lame\",\"calibrating_blade_holder_position\":\"Calibrage du porte-lame\",\"hotend_pick_place_test\":\"Test du changement de tête\",\"build_plate_alignment_detection\":\"Détection de l’alignement du plateau\",\"identifying_build_plate_type\":\"Identification du plateau\",\"measuring_surface\":\"Mesure de la surface\",\"measuring_rotary_attachment\":\"Mesure de l’accessoire rotatif\",\"motor_noise_showoff\":\"Vérification du bruit moteur\",\"calibrating_motor_noise\":\"Calibrage du bruit moteur\",\"paused_filament_runout\":\"Pause : filament épuisé\",\"calibrating_live_view_camera\":\"Calibrage de la caméra en direct\",\"calibrating_camera_offset\":\"Calibrage du décalage de caméra\",\"check_quick_release\":\"Vérification de l’attache rapide\",\"m400_pause\":\"En pause (M400)\",\"paused_low_fan_speed_heat_break\":\"Pause : ventilateur thermique lent\",\"heatbed_surface_foreign_object_detection\":\"Recherche d’objets sur le plateau\",\"heatbed_underside_foreign_object_detection\":\"Vérification sous le plateau\",\"heating_hotend\":\"Chauffage de la tête d’extrusion\",\"paused_first_layer_error\":\"Pause : erreur de première couche\",\"moving_toolhead_to_center_of_heatbed\":\"Déplacement au centre du plateau\",\"waiting_for_heatbed_temperature\":\"Attente de température du plateau\",\"checking_extruder_temperature\":\"Vérification de température d’extrudeur\",\"calibrate_nozzle_offset\":\"Calibrage du décalage de buse\",\"paused_chamber_temperature_control_error\":\"Pause : erreur de température d’enceinte\",\"waiting_chamber_temperature_equalize\":\"Attente de température d’enceinte\",\"paused_nozzle_temperature_malfunction\":\"Pause : erreur de température de buse\",\"homing_toolhead\":\"Retour à l’origine de la tête\",\"paused_front_cover_falling\":\"Pause : capot avant détaché\",\"heated_bedcooling\":\"Refroidissement du plateau\",\"paused_heat_bed_temperature_malfunction\":\"Pause : erreur de température du plateau\",\"heating_chamber\":\"Chauffage de l’enceinte\",\"paused_nozzle_filament_covered_detected\":\"Pause : filament sur la buse\",\"paused_cutter_error\":\"Pause : erreur du coupe-fil\",\"purifying_chamber_air\":\"Purification de l’air de l’enceinte\",\"heatbed_preheating\":\"Préchauffage du plateau\",\"paused_user\":\"Pause par l’utilisateur\",\"thermal_preconditioning\":\"Préconditionnement thermique\",\"sweeping_xy_mech_mode\":\"Vérification mécanique XY\"},\"abort_confirm\":\"Abandonner l’impression\"},"
    "\"autoupdate\":{\"rollback_title\":\"Mise à jour annulée\",\"rollback_message\":\"La mise à jour automatique vers\",\"rollback_message2\":\"a échoué. Le panneau a restauré le micrologiciel précédent et ne réessaiera pas cette version.\"},"
    "\"todo\":{\"empty\":\"aucune tâche ouverte\",\"loading\":\"chargement...\"},"
    "\"settings\":{\"wifi\":{\"ssid\":\"SSID\"}},"
    "\"boot\":{\"initializing_system\":\"Initialisation du systeme\",\"initializing_wifi\":\"Initialisation Wi-Fi\",\"initializing_touch\":\"Initialisation tactile\",\"wifi_setup_title\":\"Configuration Wi-Fi\",\"wifi_connect_failed\":\"Echec connexion Wi-Fi\",\"wifi_credentials_missing\":\"Identifiants Wi-Fi manquants\",\"open_editor\":\"Ouvrir BETTA Editor:\",\"ha_setup_title\":\"Configuration Home Assistant\",\"wifi_connected\":\"Wi-Fi connecte\",\"ha_credentials_missing\":\"Identifiants HA manquants\",\"set_ha_url_token\":\"Definir URL HA et token\",\"loading_dashboard\":\"Chargement du tableau de bord\",\"setup_ap_prefix\":\"AP de configuration\",\"setup_ap_password\":\"Mot de passe\",\"offline_mode\":\"Mode hors ligne\",\"wifi_unreachable\":\"Wi-Fi inaccessible\",\"wifi_auto_reconnect\":\"Reconnexion automatique dès son retour\",\"wifi_or_setup\":\"Ou reconfigurez, point d’accès :\"},"
    "\"xiaozhi\":{\"title\":\"AI Assistant\",\"talk\":\"Maintenir pour parler\",\"state\":{\"disabled\":\"Désactivé\",\"ready\":\"Prêt\",\"connecting\":\"Connexion\",\"listening\":\"Écoute en cours\",\"waiting\":\"En attente de réponse\",\"speaking\":\"Lecture en cours\",\"speaking_listening\":\"Parle et écoute\",\"pairing\":\"Associez sur xiaozhi.me avec le code\",\"pairing_retry\":\"Service indisponible ; nouvel essai\",\"pairing_error\":\"Échec de l’association\",\"pairing_expired\":\"Association expirée ; réessayez\",\"pair_first\":\"Associez d’abord l’appareil\",\"connection_error\":\"Connexion interrompue ; réessayez\",\"audio_or_connection_error\":\"Audio ou connexion indisponible\",\"storage_error\":\"Impossible d’enregistrer les réglages\",\"memory_error\":\"Mémoire insuffisante\",\"unsupported\":\"Cette carte ne prend pas en charge la voix\",\"wake_error\":\"Réveil vocal indisponible ; utilisez le bouton de parole\"},\"wake\":\"Réveil vocal\",\"wake_hint\":\"Dites « Ni hao Xiao Zhi » pour commencer. Le mot de réveil est reconnu localement.\",\"timeout\":\"La conversation se termine après un au revoir ou 30 secondes sans voix ni lecture audio.\",\"recognized\":\"Parole reconnue\",\"reply\":\"Réponse de l’IA\",\"privacy\":\"Désactivé par défaut. La détection facultative du mot de réveil reste locale. Après le réveil ou la touche de parole, le son est envoyé au service vocal associé. L’association partage l’identité de l’appareil.\",\"emoji_style\":\"Style des émotions de l’IA\",\"emoji_otto\":\"Robot Otto\",\"emoji_classic\":\"Emojis classiques\",\"you\":\"Vous\",\"assistant\":\"AI Assistant\",\"hint_duplex\":\"Je parle et je vous écoute\",\"hint_listening\":\"Allez-y, je vous écoute\",\"hint_thinking\":\"Un instant\",\"hint_ready\":\"Dites le mot de réveil pour commencer une conversation\",\"hint_error\":\"Réactivez-moi pour réessayer\",\"hint_timeout\":\"Retour à l’accueil dans %u s · Parlez pour continuer\",\"hint_manual_error\":\"Maintenez pour parler et réessayer\",\"hint_timeout_manual\":\"Retour à l’accueil dans %u s · Maintenez pour parler\"},"
    "\"ota\":{\"title\":\"Mise à jour du micrologiciel\",\"preparing\":\"Préparation de la mise à jour\",\"downloading\":\"Téléchargement du micrologiciel...\",\"receiving\":\"Réception du micrologiciel...\",\"writing\":\"Écriture du micrologiciel\",\"success\":\"Mise à jour écrite. Redémarrage...\",\"failed\":\"Échec de la mise à jour. Consultez l’éditeur.\",\"writing_version\":\"Écriture du firmware %s\",\"unknown_size\":\"%s / inconnu\"},"
    "\"titles\":{\"car\":\"Voiture\",\"solar\":\"Prévisions solaires\",\"sonos\":\"Favoris Sonos\",\"printer\":\"Imprimante Bambu\"},"
    "\"screen\":{\"title\":\"Réglages système\",\"active\":\"Luminosité\",\"dim\":\"Luminosité réduite\",\"dim_seconds\":\"Atténuer après (secondes)\",\"mode\":\"Après inactivité\",\"start_minutes\":\"Démarrer après (minutes)\",\"clock_start\":\"Afficher l’horloge après (secondes)\",\"clock_brightness\":\"Luminosité de l’horloge\",\"clock_off\":\"Éteindre après l’horloge\",\"clock_off_seconds\":\"Afficher l’horloge pendant (secondes)\",\"clock_24h\":\"Horloge sur 24 heures\",\"clock_seconds\":\"Afficher les secondes\",\"clock_date\":\"Afficher la date\",\"disabled\":\"Désactivé\",\"clock\":\"Horloge\",\"off\":\"Éteindre l’écran\",\"weather\":\"Météo\",\"pages\":\"Faire défiler les pages\",\"cancel\":\"Annuler\",\"save\":\"Enregistrer\",\"hint\":\"Les changements s’appliquent à l’enregistrement.\",\"saving\":\"Enregistrement...\",\"failed\":\"Échec de l’enregistrement. Réessayez.\",\"load_failed\":\"Réglages indisponibles. Fermez puis réessayez.\",\"preview\":\"Aperçu (30 s)\",\"clock_analog\":\"Horloge analogique\",\"clock_style\":\"Style d’horloge\",\"clock_digital\":\"Horloge numérique\",\"clock_flip\":\"Horloge à volets\",\"rotation\":\"Rotation de l’écran\",\"auto_rotation\":\"Rotation automatique\",\"xiaozhi_emoji\":\"Style des émotions de l’IA\"},"
    "\"system\":{\"language\":\"Langue\",\"timezone\":\"Fuseau horaire\",\"appearance\":\"Apparence\",\"theme\":\"Thème de couleurs\",\"flat\":\"Plat\",\"glow\":\"Lumineux\",\"glass\":\"Verre\",\"matte\":\"Mat\",\"dark_v2\":\"Sombre\",\"classic_v1\":\"Classique\",\"light\":\"Clair\",\"ocean\":\"Océan\",\"contrast\":\"Contraste élevé\",\"black\":\"Noir pur\",\"page_animations\":\"Animations des pages\",\"on\":\"Activé\",\"off\":\"Désactivé\"},"
    "\"alerts\":{\"title\":\"Alertes\",\"empty\":\"Aucune alerte\",\"unknown\":\"Inconnu\",\"crash\":\"Rapport de plantage conservé\",\"ppa\":\"Délai de l’accélérateur graphique dépassé\",\"lvgl\":\"Tâche d’affichage bloquée\",\"runtime\":\"Tâche d’interface bloquée\",\"time\":\"Heure\",\"task\":\"Tâche\",\"reason\":\"Cause\",\"version\":\"Version\",\"build\":\"Compilation\",\"retained\":\"Rapport historique, pas nécessairement une panne actuelle. Téléchargez-le ou supprimez-le dans Paramètres web > Appareil.\",\"wifi\":\"Wi-Fi déconnecté\",\"wifi_detail\":\"Le panneau ne peut pas se connecter au Wi-Fi. Vérifiez le point d’accès et les paramètres réseau. La reconnexion est automatique.\",\"ha\":\"Home Assistant déconnecté\",\"ha_detail\":\"Les données peuvent être obsolètes. Vérifiez Home Assistant et la connexion dans les paramètres web.\",\"mqtt\":\"MQTT déconnecté\",\"mqtt_detail\":\"Les notifications MQTT sont indisponibles. Vérifiez le serveur et les paramètres MQTT. La reconnexion est automatique.\",\"entity\":\"Entité\",\"state\":\"État\",\"sensor\":\"Alerte de capteur / sonnette\"},"
    "\"price\":{\"today\":\"Aujourd'hui\",\"tomorrow\":\"Demain\",\"min\":\"min\",\"max\":\"max\",\"average\":\"Moyenne\",\"cheap\":\"Économique\",\"no_cheap\":\"Plus de plage économique\",\"no_data\":\"Aucun prix\",\"no_today\":\"Aucun prix pour aujourd’hui\",\"no_tomorrow\":\"Demain pas encore publié\",\"no_clock\":\"Horloge indisponible\"},"
    "\"parqet\":{\"xirr\":\"XIRR\",\"ttwror\":\"TTWROR\",\"dividends\":\"Dividendes\",\"realized\":\"Réalisés\",\"performance\":\"Performance\",\"holdings\":\"Positions\",\"loading\":\"Chargement\",\"no_answer\":\"Aucune réponse (peut-être trop volumineuse)\",\"failed\":\"Indisponible\",\"no_data\":\"Aucune donnée\",\"largest\":\"Principales\",\"top\":\"5 meilleures\",\"flop\":\"5 moins bonnes\",\"pick_interval\":\"Choisir une période\",\"unit_mismatch\":\"Unité différente\",\"period\":{\"1d\":\"1J\",\"1w\":\"1S\",\"1m\":\"1M\",\"ytd\":\"Année\",\"max\":\"MAX\"}},"
    "\"stock\":{\"title\":\"Actions et ETF\",\"lookup_failed\":\"Source inconnue\",\"unsupported\":\"Pas un cours boursier\",\"period\":{\"1d\":\"1J\",\"1w\":\"1S\",\"30d\":\"1M\",\"ytd\":\"YTD\",\"1y\":\"1A\"},\"source\":{\"closes\":\"Cours de clôture\",\"recorded\":\"Enregistré\",\"averages\":\"Moyennes HA\"},\"since\":\"depuis\",\"from\":\"à partir de\",\"prev_close\":\"clôture préc.\",\"trend\":\"tendance\",\"history_failed\":\"Historique indisponible\",\"history_empty\":\"Aucun historique pour cette période\",\"market\":{\"open\":\"Marché ouvert\",\"pre\":\"Avant ouverture\",\"post\":\"Après clôture\",\"closed\":\"Marché fermé\"},\"updated\":\"mis à jour\",\"last_price\":\"dernier cours\",\"start\":\"Début\"},"
    "\"air\":{\"title\":\"Qualité de l’air\",\"humidity\":\"Humidité\",\"humidity_short\":\"Humidité\",\"temperature\":\"Température\",\"temperature_short\":\"Temp.\",\"co2\":\"CO₂\",\"pm25\":\"PM2.5\",\"voc\":\"COV\",\"out_temperature\":\"Température extérieure\",\"out_temperature_short\":\"Temp. ext.\",\"out_humidity\":\"Humidité extérieure\",\"window\":\"Contact de fenêtre\",\"rating\":\"Évaluation de l’appareil\",\"good\":\"Bonne\",\"fair\":\"Acceptable\",\"poor\":\"Mauvaise\",\"not_evaluated\":\"Non évaluée\",\"partial\":\"Données partielles\",\"dry\":\"Humidité faible\",\"humid\":\"Humidité élevée · vérifier l’aération\",\"fresh_air\":\"Renouveler l’air · CO₂ élevé\",\"particles\":\"Particules élevées · réduire les sources / filtrer ; qualité extérieure inconnue\",\"drying\":\"L’air de référence peut aider à assécher la pièce\",\"no_drying\":\"L’air de référence n’assèche pas suffisamment\",\"conflict\":\"Renouvellement nécessaire ; l’air de référence apporterait de l’humidité\",\"conflict_short\":\"Aérer · conflit d’humidité\",\"co2_short\":\"Aérer · CO₂ élevé\",\"humid_short\":\"Humidité élevée\",\"pm_short\":\"Particules élevées\",\"humidity_scope\":\"Humidité seule\",\"no_advice\":\"Données évaluées insuffisantes pour un conseil\",\"absolute\":\"Humidité absolue : intérieur / extérieur\",\"weather_reference\":\"Référence météo ; aucune mesure extérieure locale. Ancienneté inconnue.\",\"open\":\"Ouverte\",\"closed\":\"Fermée\",\"enum_extremely_poor\":\"Extrêmement mauvaise\",\"enum_very_poor\":\"Très mauvaise\",\"enum_poor\":\"Mauvaise\",\"enum_fair\":\"Acceptable\",\"enum_good\":\"Bonne\",\"enum_moderate\":\"Modérée\",\"choose_humidity\":\"Choisir un capteur d’humidité\",\"blank\":\"Widget de qualité de l’air vide\",\"outdoor_enabled\":\"Comparer avec l’extérieur\",\"sources_hint\":\"L’humidité est obligatoire. Affectez explicitement les autres rôles. Les COV sont seulement affichés ; l’évaluation de l’appareil ne change pas l’état BETTA. Associez température et humidité extérieures.\",\"invalid_binding\":\"Entité non valide pour {role}.\"},"
    "\"network\":{\"ethernet\":\"Ethernet\",\"interface\":\"Connexion\"}"
    "}}";
