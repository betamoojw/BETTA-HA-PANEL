/* SPDX-License-Identifier: LicenseRef-FNCL-1.1
 * Copyright (c) 2026 andre68723
 * Generated by tools/generate_i18n.py; edit the JSON catalog.
 */
static const char I18N_BUILTIN_ZH_CN[] =
    "{\"lvgl\":{"
    "\"common\":{\"on\":\"开\",\"off\":\"关\",\"unavailable\":\"不可用\",\"paused\":\"已暂停\",\"playing\":\"播放中\",\"start\":\"开始\",\"pause\":\"暂停\",\"unknown\":\"未知\"},"
    "\"cover\":{\"open\":\"打开\",\"closed\":\"已关闭\",\"opening\":\"打开中\",\"closing\":\"关闭中\",\"moving\":\"移动中\"},"
    "\"datetime\":{\"date\":\"日期\",\"time\":\"时间\",\"save\":\"保存\",\"cancel\":\"取消\",\"invalid\":\"日期或时间无效\",\"failed\":\"保存失败\"},"
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    "\"car\":{\"precond\":\"预调温\",\"precond_pending\":\"正在发送…\"},"
    "\"fan\":{\"oscillate\":\"摇头\"},"
    "\"contact\":{\"open\":\"打开\",\"opened\":\"已打开\",\"closed\":\"已关闭\"},"
    "\"climate\":{\"current\":\"当前\",\"fan_short\":\"风速\",\"fan_title\":\"风速模式\",\"mode_title\":\"模式\",\"swing_short\":\"摆风\",\"swing_title\":\"摆风模式\",\"mode\":{\"off\":\"关闭\",\"heat\":\"制热\",\"cool\":\"制冷\",\"auto\":\"自动\",\"dry\":\"除湿\",\"fan_only\":\"送风\",\"heat_cool\":\"冷暖\",\"cooling\":\"制冷中\",\"drying\":\"除湿中\",\"idle\":\"空闲\",\"fan\":\"风扇\",\"defrosting\":\"除霜中\",\"preheating\":\"预热中\",\"vertical\":\"上下\",\"horizontal\":\"左右\",\"both\":\"上下左右\"}},"
    "\"roborock\":{\"fan_title\":\"吸力档位\",\"ready\":\"就绪\",\"cleaning\":\"清扫中\",\"returning\":\"返回中\",\"dock\":\"回充\",\"fan\":\"吸力\",\"clean_selected_short\":\"清扫\",\"map_ready\":\"地图已连接\",\"map_loading\":\"正在加载地图\",\"map_waiting\":\"等待地图\",\"map_failed\":\"地图预览不可用\",\"ready_to_charge\":\"已在基站\",\"mode\":\"模式\",\"mode_title\":\"清洁模式\",\"send_failed\":\"Command not sent\",\"not_connected\":\"Home Assistant 未连接\",\"state\":{\"cleaning\":\"清扫中\",\"docked\":\"Docked\",\"returning\":\"返回中\",\"idle\":\"空闲\",\"paused\":\"已暂停\",\"error\":\"Error\",\"unavailable\":\"不可用\",\"unknown\":\"未知\",\"segment_cleaning\":\"Room cleaning\",\"room_cleaning\":\"Room cleaning\",\"zoned_cleaning\":\"Zone cleaning\",\"spot_cleaning\":\"Spot cleaning\",\"going_to_target\":\"Going to target\",\"target_found\":\"Target reached\"}},"
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    "\"energy\":{\"title\":\"能源\",\"waiting\":\"等待能源数据\",\"ha_waiting\":\"HA 能源数据\",\"today\":\"今天\",\"grid\":\"电网\",\"solar\":\"太阳能\",\"home\":\"家庭\",\"battery\":\"电池\",\"grid_in\":\"输入\",\"grid_out\":\"输出\",\"battery_charge\":\"充电\",\"battery_out\":\"放电\",\"home_now\":\"当前用电\",\"water\":\"用水\",\"gas\":\"燃气\",\"autarky\":\"自给率\",\"details_prompt\":\"选择燃气、用水或太阳能\"},"
    "\"sonos_favorites\":{\"sensor_hint\":\"需要 HA Sonos 集成并启用收藏传感器。\",\"setup_hint\":\"请在 Home Assistant 中启用 Sonos 集成及 sensor.sonos_favorites。\",\"empty\":\"未找到收藏。\"},"
    "\"evcc\":{\"wallbox\":\"充电桩\",\"add\":\"+ 充电桩 (evcc)\",\"loadpoint\":\"充电点\",\"choose\":\"选择充电点\",\"find\":\"查找充电点\",\"finding\":\"正在查找充电点…\",\"failed\":\"未确认\",\"none_found\":\"未找到已启用的 evcc 充电点\",\"replace\":\"用此充电点替换现有实体绑定？手动绑定将被替换。\",\"missing\":\"实体缺失或已禁用\",\"bound\":\"充电点已配置\",\"entities\":\"高级实体设置\",\"hint\":\"请在 Home Assistant 中启用缺失实体。重新检测会保留手动绑定。\",\"mode\":\"充电模式\",\"vehicle\":\"车辆\",\"target\":\"目标电量\",\"power\":\"充电功率（传感器）\",\"soc\":\"车辆电量（传感器）\",\"connected\":\"已连接\",\"charging\":\"充电中\",\"disabled\":\"配置中已禁用 (binary_sensor)\",\"effective\":\"实际值\",\"off\":\"关闭\",\"smart\":\"智能\",\"fast\":\"快速\",\"none\":\"无车辆\",\"ready\":\"未连接\",\"unavailable\":\"不可用\",\"pending\":\"等待中…\",\"apply\":\"应用\",\"energy\":\"充电量（传感器）\",\"remaining\":\"剩余\",\"sessions\":\"充电记录\",\"charged\":\"已充电\",\"change\":\"更改\",\"last\":\"上次充电\",\"power_label\":\"功率\",\"soc_label\":\"电量\",\"target_label\":\"目标电量\",\"car\":\"车辆\",\"start\":\"开始\",\"sessions_loading\":\"正在加载充电记录…\",\"sessions_error\":\"充电记录加载失败\",\"sessions_empty\":\"无已完成的充电记录\",\"sessions_unsupported\":\"充电记录不可用\",\"sessions_preview\":\"请在面板上查看充电记录\",\"header_power\":\"Charging power\",\"flow_pv\":\"PV\",\"flow_battery\":\"电池\",\"flow_grid\":\"电网\",\"flow_home\":\"家庭\",\"flow_car\":\"车辆\",\"flow_export\":\"Export\",\"guest\":\"Guest vehicle\"},"
    "\"camera\":{\"live\":\"实时摄像头\",\"connecting\":\"正在连接…\",\"paused\":\"已暂停\",\"waiting\":\"等待摄像头\",\"unsupported\":\"MJPEG 不可用\",\"failed\":\"摄像头连接已断开\"},"
    "\"bambu\":{\"state\":{\"missing\":\"无数据\",\"unavailable\":\"不可用\",\"other\":\"未知\",\"offline\":\"离线\",\"idle\":\"空闲\",\"init\":\"启动中\",\"prepare\":\"准备中\",\"slicing\":\"切片中\",\"running\":\"打印中\",\"pause\":\"已暂停\",\"finish\":\"已完成\",\"failed\":\"失败\"},\"pause\":\"暂停\",\"resume\":\"继续\",\"stop\":\"停止\",\"status\":\"状态\",\"nozzle\":\"喷嘴\",\"bed\":\"热床\",\"progress\":\"进度\",\"remaining\":\"剩余\",\"min\":\"分钟\",\"stage\":\"步骤\",\"job\":\"任务\",\"stop_title\":\"停止此次打印？\",\"cancel\":\"取消\",\"not_confirmed\":\"命令未确认\",\"send_failed\":\"命令发送失败\",\"sending\":\"正在发送…\",\"last_job\":\"上次任务\",\"details\":\"打印机状态\",\"not_connected\":\"Home Assistant 未连接\",\"step\":{\"filament_loading\":\"Loading filament\",\"print_calibration_lines\":\"Printing calibration lines\",\"preparing_ams\":\"Preparing AMS\",\"preparing_hotend\":\"Preparing hotend\",\"moving_toolhead_above_purge_chute\":\"Moving to purge chute\",\"paused_nozzle_clog\":\"Paused: nozzle clogged\",\"check_plaform\":\"Checking platform\",\"bed_level_phase_1\":\"Bed leveling 1\",\"bed_level_phase_2\":\"Bed leveling 2\",\"bed_level_high_temperature\":\"High-temperature bed leveling\",\"auto_bed_leveling\":\"Auto bed leveling\",\"calibrating_detection_nozzle_clumping\":\"Calibrating clump detection\",\"calibrating_cutter_model_offset\":\"Calibrating cutter offset\",\"scanning_bed_surface\":\"Scanning bed surface\",\"inspecting_first_layer\":\"Inspecting first layer\",\"hotend_type_detection\":\"Detecting hotend type\",\"check_material\":\"Checking material\",\"check_material_position\":\"Checking material position\",\"calibrating_extrusion\":\"Calibrating extrusion\",\"calibrating_extrusion_flow\":\"Calibrating flow\",\"paused_skipped_step\":\"Paused: skipped step\",\"cooling_chamber\":\"Cooling chamber\",\"check_door_and_cover\":\"Checking door and cover\",\"cleaning_nozzle_tip\":\"Cleaning nozzle tip\",\"calibrating_micro_lidar\":\"Calibrating micro lidar\",\"laser_calibration\":\"Laser calibration\",\"cooling_nozzle\":\"Cooling nozzle\",\"filament_unloading\":\"Unloading filament\",\"active_arc_fitting\":\"Arc fitting\",\"paused_ams_lost\":\"Paused: AMS lost\",\"absolute_accuracy_calibration\":\"Accuracy calibration\",\"check_absolute_accuracy_before_calibration\":\"Checking accuracy\",\"check_absolute_accuracy_after_calibration\":\"Checking accuracy\",\"paused_user_gcode\":\"Paused by G-code\",\"calibrate_birdeye_camera\":\"Calibrating overview camera\",\"check_birdeye_camera_position\":\"Checking overview camera\",\"pre_extrusion_before_printing\":\"Pre-extruding\",\"changing_filament\":\"Changing filament\",\"homing_blade_holder\":\"Homing blade holder\",\"calibrating_blade_holder_position\":\"Calibrating blade holder\",\"hotend_pick_place_test\":\"Testing hotend change\",\"build_plate_alignment_detection\":\"Detecting plate alignment\",\"identifying_build_plate_type\":\"Identifying build plate\",\"measuring_surface\":\"Measuring surface\",\"measuring_rotary_attachment\":\"Measuring rotary attachment\",\"motor_noise_showoff\":\"Motor noise check\",\"calibrating_motor_noise\":\"Calibrating motor noise\",\"paused_filament_runout\":\"Paused: filament ran out\",\"calibrating_live_view_camera\":\"Calibrating live camera\",\"calibrating_camera_offset\":\"Calibrating camera offset\",\"check_quick_release\":\"Checking quick release\",\"m400_pause\":\"Paused (M400)\",\"paused_low_fan_speed_heat_break\":\"Paused: heatbreak fan slow\",\"heatbed_surface_foreign_object_detection\":\"Checking bed for objects\",\"heatbed_underside_foreign_object_detection\":\"Checking under the bed\",\"heating_hotend\":\"Heating hotend\",\"paused_first_layer_error\":\"Paused: first layer error\",\"moving_toolhead_to_center_of_heatbed\":\"Moving to bed center\",\"waiting_for_heatbed_temperature\":\"Waiting for bed temperature\",\"checking_extruder_temperature\":\"Checking extruder temperature\",\"calibrate_nozzle_offset\":\"Calibrating nozzle offset\",\"paused_chamber_temperature_control_error\":\"Paused: chamber temperature error\",\"waiting_chamber_temperature_equalize\":\"Waiting for chamber temperature\",\"paused_nozzle_temperature_malfunction\":\"Paused: nozzle temperature error\",\"homing_toolhead\":\"Homing toolhead\",\"paused_front_cover_falling\":\"Paused: front cover fell\",\"heated_bedcooling\":\"Cooling bed\",\"paused_heat_bed_temperature_malfunction\":\"Paused: bed temperature error\",\"heating_chamber\":\"Heating chamber\",\"paused_nozzle_filament_covered_detected\":\"Paused: filament on nozzle\",\"paused_cutter_error\":\"Paused: cutter error\",\"purifying_chamber_air\":\"Purifying chamber air\",\"heatbed_preheating\":\"Preheating bed\",\"paused_user\":\"Paused by user\",\"thermal_preconditioning\":\"Thermal preconditioning\",\"sweeping_xy_mech_mode\":\"Checking XY mechanics\"},\"abort_confirm\":\"Abort print\"},"
    "\"autoupdate\":{\"rollback_title\":\"更新已回退\",\"rollback_message\":\"自动更新至\",\"rollback_message2\":\"失败。面板已恢复原固件，不会再次尝试此版本。\"},"
    "\"todo\":{\"empty\":\"无待办事项\",\"loading\":\"正在加载…\"},"
    "\"settings\":{\"wifi\":{\"ssid\":\"SSID\"}},"
    "\"boot\":{\"initializing_system\":\"正在初始化系统\",\"initializing_wifi\":\"正在初始化 Wi-Fi\",\"initializing_touch\":\"正在初始化触摸\",\"wifi_setup_title\":\"Wi-Fi 配网\",\"wifi_connect_failed\":\"Wi-Fi 连接失败\",\"wifi_credentials_missing\":\"未配置 Wi-Fi 凭据\",\"open_editor\":\"打开 BETTA 编辑器：\",\"ha_setup_title\":\"Home Assistant 设置\",\"wifi_connected\":\"Wi-Fi 已连接\",\"ha_credentials_missing\":\"未配置 HA 凭据\",\"set_ha_url_token\":\"设置 HA 地址和令牌\",\"loading_dashboard\":\"正在加载仪表盘\",\"setup_ap_prefix\":\"配网热点\",\"setup_ap_password\":\"密码\",\"offline_mode\":\"离线模式\"},"
    "\"xiaozhi\":{\"title\":\"小智 AI\",\"talk\":\"按住讲话\",\"state\":{\"disabled\":\"已停用\",\"ready\":\"就绪\",\"connecting\":\"正在连接\",\"listening\":\"正在聆听\",\"waiting\":\"等待回复\",\"speaking\":\"正在播放\",\"pairing\":\"请在 xiaozhi.me 输入配对码\",\"pairing_retry\":\"配对服务不可用，正在重试\",\"pairing_error\":\"配对失败\",\"pairing_expired\":\"配对已超时，请重试\",\"pair_first\":\"请先配对设备\",\"connection_error\":\"连接已中断，请重试\",\"audio_or_connection_error\":\"音频或连接不可用\",\"storage_error\":\"无法保存设置\",\"memory_error\":\"内存不足\",\"unsupported\":\"此板型不支持语音音频\",\"wake_error\":\"语音唤醒不可用，请按住说话\"},\"wake\":\"语音唤醒\",\"wake_hint\":\"说“你好小智”开始对话。唤醒词在面板本地识别。\",\"timeout\":\"对话空闲超时（秒）\",\"recognized\":\"识别到的语音\",\"reply\":\"AI 回复\",\"privacy\":\"默认关闭。可选的唤醒词识别在面板本地进行。唤醒或按住说话后，对话音频会发送至小智。配对会共享设备标识。\",\"emoji_style\":\"AI 表情样式\",\"emoji_otto\":\"Otto 机器人\",\"emoji_classic\":\"经典表情\"},"
    "\"ota\":{\"title\":\"固件更新\",\"preparing\":\"正在准备更新\",\"downloading\":\"正在下载固件…\",\"receiving\":\"正在接收固件…\",\"writing\":\"正在写入固件\",\"success\":\"更新已写入，正在重启…\",\"failed\":\"更新失败，请在编辑器中查看详情。\",\"writing_version\":\"Writing firmware %s\",\"unknown_size\":\"%s / unknown\"},"
    "\"titles\":{\"car\":\"车辆\",\"solar\":\"太阳能预测\",\"sonos\":\"Sonos 收藏\",\"printer\":\"Bambu 打印机\"},"
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    "\"stock\":{\"title\":\"Stocks & ETFs\",\"lookup_failed\":\"Source unknown\",\"unsupported\":\"Not a quote\",\"period\":{\"1d\":\"1D\",\"1w\":\"1W\",\"30d\":\"30D\",\"ytd\":\"YTD\",\"1y\":\"1Y\"},\"source\":{\"closes\":\"Closes\",\"recorded\":\"Recorded\",\"averages\":\"HA averages\"},\"since\":\"since\",\"from\":\"from\",\"prev_close\":\"prev. close\",\"trend\":\"trend\",\"history_failed\":\"History not available\",\"history_empty\":\"No history for this period\",\"market\":{\"open\":\"Market open\",\"pre\":\"Pre-market\",\"post\":\"After hours\",\"closed\":\"Market closed\"},\"updated\":\"updated\",\"last_price\":\"last price\"}"
    "}}";
